// SPDX-License-Identifier: GPL-2.0-or-later
/* Copyright (c) 2025, Natalie Moore <natalie@natalielucy.dev> */

#include "qcom-ipq4019-ibr-c.dtsi"

/ {
	model = "Cradlepoint IBR600C";
	compatible = "cradlepoint,ibr600c";
};
